/delete-node/ &kscan2;

/ {
    kscan2: kscan2 {
        compatible = "zmk,kscan-gpio-direct";
input-gpios
    = <&gpio0 10 (GPIO_ACTIVE_LOW | GPIO_PULL_UP)>   /* RC(8,0) */
    , <&gpio0 31 (GPIO_ACTIVE_LOW | GPIO_PULL_UP)>   /* RC(8,1) */
    , <&gpio1 12 (GPIO_ACTIVE_LOW | GPIO_PULL_UP)>   /* RC(8,2) ← 1uキー */
    ;
    };
};